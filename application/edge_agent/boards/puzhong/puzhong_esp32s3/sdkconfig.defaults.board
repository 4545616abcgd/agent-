## application/volc_rtc_agent/main/Kconfig.projbuild
```kconfig
menu "ESP-Claw RTC Agent"

    config RTC_AGENT_WIFI_SSID
        string "Wi-Fi SSID"
        default ""
        help
            When empty, reuse wifi_ssid from the existing ESP-Claw "app"
            NVS namespace.

    config RTC_AGENT_WIFI_PASSWORD
        string "Wi-Fi password"
        default ""
        help
            Used with RTC_AGENT_WIFI_SSID. When the SSID is empty, load the
            matching retained wifi_password from NVS instead.

    config VOLC_RTC_MODE
        bool
        default y

    config RTC_AGENT_VOLC_INSTANCE_ID
        string "Volc hardware-agent InstanceID"
        default ""
        help
            InstanceID from the hardware conversational-agent product page.

    config RTC_AGENT_VOLC_PRODUCT_KEY
        string "Volc hardware-agent ProductKey"
        default ""

    config RTC_AGENT_VOLC_PRODUCT_SECRET
        string "Volc hardware-agent ProductSecret"
        default ""
        help
            Keep this value only in the local, git-ignored sdkconfig file.

    config RTC_AGENT_VOLC_DEVICE_NAME
        string "Hardware-agent device name"
        default "espclaw-dcb4d905d268"

    config RTC_AGENT_VOLC_BOT_ID
        string "Associated conversational-agent Bot ID"
        default ""

    config RTC_AGENT_AUTO_START
        bool "Start an RTC session immediately after Wi-Fi connects"
        default n
        help
            Intended only for bring-up. The product default waits for the
            local wake phrase before starting a cloud conversation.

    config RTC_AGENT_SESSION_MAX_SECONDS
        int "Maximum continuous RTC session duration"
        range 60 3600
        default 1800

    config RTC_AGENT_I2S_BCLK_GPIO
        int "I2S BCLK GPIO"
        range 0 48
        default 4

    config RTC_AGENT_I2S_WS_GPIO
        int "I2S WS/LRCLK GPIO"
        range 0 48
        default 5

    config RTC_AGENT_I2S_MIC_GPIO
        int "INMP441 data GPIO"
        range 0 48
        default 6

    config RTC_AGENT_I2S_SPK_GPIO
        int "MAX98357A data GPIO"
        range 0 48
        default 17

    config RTC_AGENT_MIC_RIGHT_SLOT
        bool "INMP441 L/R pin selects the right slot"
        default n

    config RTC_AGENT_MIC_GAIN
        int "Microphone digital gain"
        range 1 32
        default 16

    config RTC_AGENT_SPEAKER_GAIN_PERCENT
        int "Speaker digital gain percent"
        range 1 100
        default 80

    config RTC_AGENT_AEC_REFERENCE_DELAY_MS
        int "AEC playback-reference delay in milliseconds"
        range 0 200
        default 40
        help
            Compensates amplifier, acoustic, and I2S DMA latency. Tune in
            10 ms steps from captured AEC diagnostics after hardware tests.

endmenu
```

## application/volc_rtc_agent/sdkconfig.defaults
```kconfig
CONFIG_IDF_TARGET="esp32s3"
CONFIG_ESP32_S3_KORVO2_V3_BOARD=y

CONFIG_PARTITION_TABLE_CUSTOM=y
CONFIG_PARTITION_TABLE_CUSTOM_FILENAME="partitions.csv"
CONFIG_ESPTOOLPY_FLASHSIZE_16MB=y
CONFIG_ESPTOOLPY_HEADER_FLASHSIZE_UPDATE=y
CONFIG_ESPTOOLPY_FLASHMODE_QIO=y
CONFIG_ESPTOOLPY_FLASHFREQ_80M=y

CONFIG_COMPILER_OPTIMIZATION_PERF=y
CONFIG_ESP_DEFAULT_CPU_FREQ_MHZ_240=y
CONFIG_ESP_MAIN_TASK_STACK_SIZE=6144
CONFIG_FREERTOS_HZ=1000
# Keep ADF recorder_sr task stacks in internal RAM. Its external-stack path
# requires an ADF-specific FreeRTOS patch that is not part of stock IDF 5.5.4.
# CONFIG_FREERTOS_TASK_CREATE_ALLOW_EXT_MEM is not set
CONFIG_FREERTOS_ENABLE_BACKWARD_COMPATIBILITY=y

CONFIG_SPIRAM=y
CONFIG_SPIRAM_MODE_OCT=y
CONFIG_SPIRAM_TYPE_AUTO=y
CONFIG_SPIRAM_SPEED_80M=y
CONFIG_SPIRAM_BOOT_INIT=y
CONFIG_SPIRAM_USE_MALLOC=y
CONFIG_SPIRAM_TRY_ALLOCATE_WIFI_LWIP=y
CONFIG_SPIRAM_MALLOC_ALWAYSINTERNAL=4096
CONFIG_SPIRAM_MALLOC_RESERVE_INTERNAL=32768
CONFIG_SPIRAM_ALLOW_BSS_SEG_EXTERNAL_MEMORY=y

CONFIG_MBEDTLS_EXTERNAL_MEM_ALLOC=y
CONFIG_ESP_WIFI_STATIC_RX_BUFFER_NUM=8
CONFIG_ESP_WIFI_DYNAMIC_RX_BUFFER_NUM=16
CONFIG_ESP_WIFI_RX_BA_WIN=8

CONFIG_MODEL_IN_FLASH=y
CONFIG_AFE_INTERFACE_V1=y
CONFIG_SR_NSN_WEBRTC=y
CONFIG_SR_VADN_WEBRTC=y
CONFIG_SR_WN_WN9_NIHAOXIAOYI_TTS2=y

CONFIG_LWIP_LOCAL_HOSTNAME="esp-claw-rtc"
CONFIG_LWIP_MAX_SOCKETS=12
CONFIG_MBEDTLS_CERTIFICATE_BUNDLE=y

# Official hardware-agent high-quality transport.
CONFIG_VOLC_RTC_MODE=y
```

## components/common/ota_service/Kconfig
```kconfig
menu "Product OTA Service"

config OTA_SERVICE_HARDWARE_ID
    string "Hardware compatibility ID"
    default "puzhong_esp32s3"
    help
        Manifest hardware must match this value (or be "*").
        Keep this stable for one PCB/hardware compatibility family.

config OTA_SERVICE_DEFAULT_MANIFEST_URL
    string "Default OTA manifest HTTPS URL"
    default ""
    help
        Optional factory default. The URL can also be provisioned at runtime
        with the `ota set manifest ...` engineering command and is stored in NVS.

config OTA_SERVICE_DEFAULT_CHANNEL
    string "Default release channel"
    default "stable"

config OTA_SERVICE_DEFAULT_AUTO_UPDATE
    bool "Automatically install a newer compatible manifest release"
    default n
    help
        Keep this disabled during bring-up. When disabled the service still
        checks the manifest periodically but does not install automatically.

config OTA_SERVICE_DEFAULT_CHECK_INTERVAL_MIN
    int "Automatic manifest check interval (minutes)"
    range 5 10080
    default 360

config OTA_SERVICE_INITIAL_CHECK_DELAY_SEC
    int "Delay after boot before first automatic check (seconds)"
    range 5 600
    default 30

config OTA_SERVICE_VALIDATE_DELAY_SEC
    int "New-image validation grace period (seconds)"
    range 5 300
    default 30
    help
        Only used when CONFIG_BOOTLOADER_APP_ROLLBACK_ENABLE is enabled.
        The new image must reach normal app boot and stay alive for this period.

config OTA_SERVICE_HTTP_TIMEOUT_MS
    int "Manifest/firmware HTTP timeout (milliseconds)"
    range 5000 120000
    default 20000

config OTA_SERVICE_MANIFEST_MAX_BYTES
    int "Maximum manifest JSON size"
    range 1024 16384
    default 4096

config OTA_SERVICE_TASK_STACK_SIZE
    int "OTA worker task stack size"
    range 6144 16384
    default 10240

config OTA_SERVICE_ALLOW_HTTP
    bool "Allow insecure HTTP URLs (development only)"
    default n
    help
        Production firmware should keep this disabled and use HTTPS only.

endmenu
```

## components/common/voice_audio/Kconfig
```kconfig
menu "Voice Audio"

    config VOICE_AUDIO_SAMPLE_RATE
        int "Voice sample rate (Hz)"
        range 8000 48000
        default 16000
        help
            Audio sample rate used by the INMP441 and MAX98357A.
            Voice V1 is designed and tested for 16000 Hz.

    config VOICE_AUDIO_BCLK_GPIO
        int "I2S BCLK GPIO"
        range 0 48
        default 4

    config VOICE_AUDIO_WS_GPIO
        int "I2S WS/LRCLK GPIO"
        range 0 48
        default 5

    config VOICE_AUDIO_MIC_DATA_GPIO
        int "INMP441 SD input GPIO"
        range 0 48
        default 6

    config VOICE_AUDIO_SPK_DATA_GPIO
        int "MAX98357A DIN output GPIO"
        range 0 48
        default 17

    config VOICE_AUDIO_MIC_SETTLE_MS
        int "Microphone settle/discard time (ms)"
        range 0 1000
        default 300
        help
            After the shared I2S TX/RX clocks start, discard this amount of
            microphone data before exposing PCM. In the current full-duplex
            setup TX is the BCLK/WS clock master during microphone capture.
            This covers INMP441 startup/standby recovery.

endmenu
```

## components/common/weather_service/Kconfig
```kconfig
menu "Weather Service"

config WEATHER_SERVICE_REFRESH_MINUTES
    int "Automatic refresh interval (minutes)"
    range 5 360
    default 30
    help
        Normal product refresh interval. A successful Wi-Fi connection triggers
        an immediate refresh; this interval controls subsequent refreshes.

config WEATHER_SERVICE_TASK_STACK_SIZE
    int "Weather service task stack size"
    range 4096 12288
    default 8192

config WEATHER_SERVICE_TASK_PRIORITY
    int "Weather service task priority"
    range 1 10
    default 4

endmenu
```
